## CMakeLists.txt
```
cmake_minimum_required(VERSION 3.20.0)

find_package(Zephyr REQUIRED HINTS $ENV{ZEPHYR_BASE})
project(sim_connect_nrf91)

target_sources(app PRIVATE
  src/main.c
  src/uart_link.c
  src/mqtt_client.c
)

# Certificado da CA do broker MQTT embutido no binario (nao e' segredo -
# e' o CA publico do broker de desenvolvimento, ver
# docs/PROTOCOLO_91_MQTT.md) - mesmo mecanismo do exercicio de
# referencia (cell-fund/l4/l4_e2).
if(CONFIG_MODEM_KEY_MGMT)
  set(gen_dir ${CMAKE_CURRENT_BINARY_DIR}/certs)
  zephyr_include_directories(${gen_dir})
  generate_inc_file_for_target(app credentials/ca-cert.pem ${gen_dir}/ca-cert.pem)
endif()
```

## Kconfig
```
#
# Coester - SIM Connect (nRF9151)
#

menu "SIM Connect - MQTT"

config SIMCONNECT_MQTT_TOPIC_PREFIX
	string "Prefixo dos topicos MQTT"
	default "topicGDF"
	help
	  Prefixo comum de todos os topicos, publicacao e assinatura -
	  ver docs/PROTOCOLO_91_MQTT.md. Nome simples escolhido pra
	  facilitar achar o proprio trafego num broker compartilhado
	  (sandbox de curso); trocar aqui quando houver mais de um
	  Gateway publicando no mesmo broker (nesse caso, algo derivado
	  do client ID/IMEI, unico por unidade, faz mais sentido).

config SIMCONNECT_MQTT_BROKER_HOSTNAME
	string "Hostname do broker MQTT"
	default "mqtt.nordicsemi.academy"
	help
	  Broker de desenvolvimento (Nordic Academy, sandbox de curso,
	  compartilhado com outros alunos - nao serve pra dado de campo
	  real). Trocar por um broker de producao e' so mudar esta
	  string, sem tocar na logica de topicos/payload.

config SIMCONNECT_MQTT_CLIENT_ID
	string "MQTT Client ID"
	help
	  Client ID customizado da conexao MQTT (identidade de sessao no
	  broker - separado do prefixo de topico acima). Se vazio,
	  gerado a partir do IMEI (nrf-<IMEI>).

endmenu

source "Kconfig.zephyr"
```

## prj.conf
```kconfig
CONFIG_GPIO=y
CONFIG_SERIAL=y
CONFIG_UART_ASYNC_API=y
CONFIG_CONSOLE=y
CONFIG_UART_CONSOLE=y
CONFIG_PRINTK=y

# Recepcao confiavel do uart1 (link com o nRF54) sem hardware flow
# control - achado em bancada (2026-08-13): o nRF54 sozinho ja tinha
# esse problema documentado (ver nrf54-app/prj.conf), mas depois de
# corrigir o lado do 54 o 91 continuou reportando UART_RX_STOPPED
# reason=4/CRC invalido ao receber DO 54 - ou seja, o uart1 do 91 tem a
# mesma fraqueza generica de recepcao (documentada pela Nordic pra serie
# nRF52/53/91, mecanismo diferente do nRF54L/H: aqui e' Kconfig puro,
# sem propriedade "timer" no devicetree). TIMER2 escolhido por estar
# livre (TIMER0/1/2 todos "disabled" no dts nativo; o tick do sistema
# usa o RTC, nao essas TIMER).
CONFIG_UART_1_NRF_HW_ASYNC=y
CONFIG_UART_1_NRF_HW_ASYNC_TIMER=2

# =====================================================================
# Integracao MQTT (docs/PROTOCOLO_91_MQTT.md) - base reaproveitada de
# C:\NordicAcademy\cell-fund\l4\l4_e2 (Nordic Academy, Cellular IoT
# Fundamentals, Licao 4 Exercicio 2)
# =====================================================================

# Sem isto, todo LOG_INF/LOG_WRN/LOG_ERR (mqtt_client.c, e tambem os
# logs INTERNOS de nrf_modem_lib/lte_lc/mqtt_helper) vira no-op em
# silencio na compilacao - achado em bancada (2026-08-14): o app nunca
# tinha usado o subsistema de Log antes (uart_link.c/main.c sao so
# printk), entao isso nunca tinha sido habilitado.
CONFIG_LOG=y

# Rede via modem (offloaded sockets - nao pilha de rede nativa do
# Zephyr, o modem cuida disso)
CONFIG_NETWORKING=y
CONFIG_NET_NATIVE=n
CONFIG_NET_SOCKETS_OFFLOAD=y
CONFIG_NET_SOCKETS=y

CONFIG_NRF_MODEM_LIB=y

CONFIG_LTE_LINK_CONTROL=y
CONFIG_LTE_NETWORK_MODE_LTE_M_NBIOT=y

# Desligado por padrao (sem "default y" no Kconfig da lib) - sem isto
# LTE_LC_EVT_MODEM_EVENT nunca chega, e diagnosticos uteis tipo
# RESET_LOOP/NO_IMEI/RF_CAL_NOT_DONE ficam invisiveis se o registro de
# rede travar (achado em bancada, 2026-08-15).
CONFIG_LTE_LC_MODEM_EVENTS_MODULE=y

CONFIG_MQTT_HELPER=y
CONFIG_MQTT_CLEAN_SESSION=y
CONFIG_MQTT_LIB_TLS=y
CONFIG_MBEDTLS=y
CONFIG_TLS_CREDENTIALS=y
CONFIG_MQTT_HELPER_SEC_TAG=24
CONFIG_MODEM_KEY_MGMT=y

# Memoria - modem+MQTT+JSON pedem mais que os defaults minimos que a
# Fase 4 (so UART) usava
CONFIG_MAIN_STACK_SIZE=4096
CONFIG_SYSTEM_WORKQUEUE_STACK_SIZE=4096
CONFIG_HEAP_MEM_POOL_SIZE=4096
```

## boards/nrf9151dk_nrf9151_ns.overlay
```dts
/*
 * Overlay para nRF9151-SMA-DK
 * Habilita a uart1 (alias arduino_serial), roteada para os pinos
 * D0 (RX) / D1 (TX) do header estilo Arduino, dedicada ao link
 * com a nRF54LM20-DK.
 *
 * A definicao de pinctrl para uart1 (uart1_default / uart1_sleep) ja
 * vem pronta no devicetree base da board -- normalmente NAO e' preciso
 * redefinir os psels aqui, so garantir que o node esta habilitado e
 * configurado sem hardware flow control (RTS/CTS), ja que vamos usar
 * so 3 fios: TX, RX, GND.
 *
 * ACHADO NA MIGRACAO PRO NCS 3.4.0 (2026-08-14): o layout de particao
 * padrao do nRF91 (nrf91xx_partition.dtsi) passou a reservar um
 * boot_partition no endereco 0 pra um bootloader (MCUboot) - que este
 * projeto nunca usou. Sem MCUboot pra pular do endereco 0 pro slot
 * real da imagem, o chip tenta executar a boot_partition vazia e trava
 * em silencio: build e flash sem erro, mas nenhum log aparece, nem o
 * banner de boot (confirmado em bancada - erase/recover nao ajuda,
 * nao e' dado velho, e' layout de memoria incompativel). Mesmo
 * sintoma relatado por outro usuario na devzone da Nordic, confirmado
 * pela propria Nordic como problema conhecido da migracao. So afeta o
 * nRF91 (o layout do nRF54 nao tem essa reserva) - por isso so o 91
 * ficava mudo, o 54 sempre bootou normal.
 *
 * Fix oficial (docs/app_dev/device_guides/nrf91/nrf91_dt_partitions.html):
 * incluir o layout de particao pronto pra TF-M sem bootloader.
 *
 * Variante "crypto" (nao "no_bootloader"): a variante minima
 * (nrf91_no_bootloader_partitions.dtsi) faz /delete-node/ nas
 * particoes de Protected Storage/ITS/OTP do TF-M - mas o Kconfig
 * padrao deste board target ja habilita CONFIG_TFM_PARTITION_
 * PROTECTED_STORAGE, e sem essa particao o build do TF-M falha
 * ("TFM_HAL_PS_FLASH_AREA_ADDR must be defined"). A variante crypto
 * mantem PS/ITS/OTP intactos, so redefine o layout do app.
 */
#include <samples/cellular/nrf91_crypto_partitions.dtsi>
#include <samples/cellular/nrf91_sram_crypto_partitions.dtsi>

&uart1 {
	status = "okay";
	current-speed = <115200>;
	/* Sem RTS/CTS: se o board file base tiver hw-flow-control
	 * habilitado, remova a linha correspondente aqui: */
	/delete-property/ hw-flow-control;
};
```

## src/main.c
```c
/*
 * nRF9151-SMA-DK
 *
 * Modulo espelho do link UART com o nRF54 (Gateway, Fase 4) +
 * integracao MQTT (docs/PROTOCOLO_91_MQTT.md). Logica de framing/
 * dispatch UART mora em uart_link.c, logica de LTE/MQTT em
 * mqtt_client.c; este main.c so inicializa os dois e cuida dos botoes
 * fisicos, que continuam existindo como gatilho MANUAL (o gatilho
 * principal agora e' "ao conectar no broker MQTT", dentro de
 * mqtt_client.c):
 *
 *   Botao 1 -> GET_STATUS de cada slot do Gateway, em sequencia
 *   Botao 2 -> GET_DISCOVERED (todos os atuadores vistos no scan)
 *
 * Os registros que chegam do 54 sao decodificados em uart_link.c, que
 * publica no MQTT (mqtt_client_publish_*) alem de logar no terminal.
 */

#include <zephyr/kernel.h>
#include <zephyr/device.h>
#include <zephyr/devicetree.h>
#include <zephyr/drivers/gpio.h>
#include <zephyr/sys/printk.h>

#include "uart_link.h"
#include "mqtt_client.h"

static const struct gpio_dt_spec button = GPIO_DT_SPEC_GET(DT_ALIAS(sw0), gpios);
static const struct gpio_dt_spec button2 = GPIO_DT_SPEC_GET(DT_ALIAS(sw1), gpios);

static struct gpio_callback button_cb_data;
static struct gpio_callback button2_cb_data;

/* Debounce por tempo, compartilhado entre os dois botoes - mesmo
 * padrao ja usado no exercicio original. */
#define DEBOUNCE_MS 200
static int64_t last_press_uptime;

static struct k_work button_work;
static struct k_work button2_work;

static void button_work_handler(struct k_work *work)
{
	ARG_UNUSED(work);

	printk("Botao 1: pedindo GET_STATUS de todos os slots...\n");
	uart_link_get_status_all();
}

static void button2_work_handler(struct k_work *work)
{
	ARG_UNUSED(work);

	printk("Botao 2: pedindo GET_DISCOVERED (todos)...\n");
	uart_link_get_discovered_all();
}

/* ISR: so faz o minimo (debounce + agendar work) - o pedido de
 * verdade (uart_tx etc.) roda na system workqueue. */
static void button_pressed(const struct device *dev, struct gpio_callback *cb, uint32_t pins)
{
	ARG_UNUSED(dev);
	ARG_UNUSED(cb);
	ARG_UNUSED(pins);

	int64_t now = k_uptime_get();

	if ((now - last_press_uptime) < DEBOUNCE_MS) {
		return;
	}
	last_press_uptime = now;

	k_work_submit(&button_work);
}

static void button2_pressed(const struct device *dev, struct gpio_callback *cb, uint32_t pins)
{
	ARG_UNUSED(dev);
	ARG_UNUSED(cb);
	ARG_UNUSED(pins);

	int64_t now = k_uptime_get();

	if ((now - last_press_uptime) < DEBOUNCE_MS) {
		return;
	}
	last_press_uptime = now;

	k_work_submit(&button2_work);
}

int main(void)
{
	int ret;

	if (!gpio_is_ready_dt(&button) || !gpio_is_ready_dt(&button2)) {
		printk("GPIO nao esta pronto\n");
		return 0;
	}

	gpio_pin_configure_dt(&button, GPIO_INPUT);
	gpio_pin_interrupt_configure_dt(&button, GPIO_INT_EDGE_TO_ACTIVE);

	gpio_pin_configure_dt(&button2, GPIO_INPUT);
	gpio_pin_interrupt_configure_dt(&button2, GPIO_INT_EDGE_TO_ACTIVE);

	gpio_init_callback(&button_cb_data, button_pressed, BIT(button.pin));
	gpio_add_callback(button.port, &button_cb_data);

	gpio_init_callback(&button2_cb_data, button2_pressed, BIT(button2.pin));
	gpio_add_callback(button2.port, &button2_cb_data);

	k_work_init(&button_work, button_work_handler);
	k_work_init(&button2_work, button2_work_handler);

	/* UART primeiro (rapido, nao bloqueia) - assim o link com o 54 ja
	 * esta pronto pra receber antes do proximo passo, que bloqueia
	 * esperando a rede LTE registrar. */
	ret = uart_link_init();
	if (ret) {
		printk("uart_link_init falhou (err %d) - sem link com o 54 por enquanto\n", ret);
	}

	printk("nRF9151: pronto. Botao 1 = GET_STATUS (todos os slots), "
	       "botao 2 = GET_DISCOVERED (todos) - gatilho manual, o principal e' "
	       "conectar no broker MQTT. Conectando...\n");

	ret = mqtt_client_start();
	if (ret) {
		printk("mqtt_client_start falhou (err %d) - sem MQTT por enquanto, "
		       "so UART/terminal\n", ret);
	}

	while (1) {
		k_sleep(K_FOREVER);
	}
}
```

## src/mqtt_client.c
```c
/*
 * Coester - SIM Connect (nRF9151)
 *
 * Integracao MQTT - contrato completo em docs/PROTOCOLO_91_MQTT.md.
 * Base reaproveitada quase 1:1 de C:\NordicAcademy\cell-fund\l4\l4_e2
 * (Nordic Academy, Cellular IoT Fundamentals, Licao 4 Exercicio 2):
 * `modem_configure()`, `client_id_get()`, `certificate_provision()`,
 * formato dos callbacks e o helper `publish()`.
 *
 * Payloads sao JSON simples, montados/lidos por busca textual direta
 * (snprintk pra montar, strstr/strtol pra ler) em vez de uma
 * biblioteca de JSON - as mensagens tem forma fixa e pequena (ver
 * tabelas no protocolo), nao vale a complexidade extra por enquanto.
 *
 * Comandos que chegam do topico de assinatura (`.../cmd`) NAO chamam
 * uart_link_* direto no callback: o callback da mqtt_helper roda numa
 * thread da biblioteca, diferente da system workqueue que os botoes
 * (main.c) ja usam pra chamar as mesmas funcoes - chamar dos dois
 * lugares sem coordenacao seria uma corrida real nas variaveis
 * estaticas do uart_link.c (fila de saida, tx_busy, etc.). Por isso
 * todo comando (vindo de fora ou gerado aqui dentro, tipo a
 * sincronizacao inicial) passa por uma fila (`k_msgq`, thread-safe) +
 * um k_work que roda na system workqueue - a MESMA thread que os
 * botoes usam, entao nunca colide.
 */

#include <stdio.h>
#include <stdlib.h>
#include <string.h>
#include <zephyr/kernel.h>
#include <zephyr/net/socket.h>
#include <zephyr/logging/log.h>
#include <modem/nrf_modem_lib.h>
#include <nrf_modem_at.h>
#include <modem/lte_lc.h>
#include <modem/modem_key_mgmt.h>
#include <net/mqtt_helper.h>

#include "uart_link.h"
#include "mqtt_client.h"

LOG_MODULE_REGISTER(mqtt_client, LOG_LEVEL_INF);

#define IMEI_LEN             15
#define CGSN_RESPONSE_LENGTH (IMEI_LEN + 6 + 1) /* \r\nOK\r\n + \0 */
#define CLIENT_ID_LEN         (sizeof("nrf-") + IMEI_LEN)

#define SUBSCRIBE_TOPIC_ID 1234

static K_SEM_DEFINE(lte_connected, 0, 1);
static uint8_t client_id[CLIENT_ID_LEN];
static bool mqtt_connected;

static char cmd_topic[sizeof(CONFIG_SIMCONNECT_MQTT_TOPIC_PREFIX) + sizeof("/cmd")];

static const unsigned char ca_certificate[] = {
#include "ca-cert.pem"
};

/* --- Fila de comandos (ver nota grande no topo do arquivo) --- */

#define CMD_JSON_MAX_LEN 320

struct pending_cmd {
	char json[CMD_JSON_MAX_LEN];
};
K_MSGQ_DEFINE(cmd_msgq, sizeof(struct pending_cmd), 4, 4);
static struct k_work cmd_work;

/* --- Helpers de JSON "na unha" (ver nota grande no topo) --- */

static bool json_get_str(const char *buf, const char *key, char *out, size_t out_len)
{
	char pattern[32];
	const char *p;
	const char *start;
	size_t n;

	snprintk(pattern, sizeof(pattern), "\"%s\"", key);
	p = strstr(buf, pattern);
	if (!p) {
		return false;
	}
	p = strchr(p + strlen(pattern), ':');
	if (!p) {
		return false;
	}
	p++;
	while (*p == ' ') {
		p++;
	}
	if (*p != '"') {
		return false;
	}
	p++;
	start = p;
	while (*p && *p != '"') {
		p++;
	}
	if (*p != '"') {
		return false;
	}
	n = (size_t)(p - start);
	if (n >= out_len) {
		n = out_len - 1;
	}
	memcpy(out, start, n);
	out[n] = '\0';
	return true;
}

static bool json_get_int(const char *buf, const char *key, long *out)
{
	char pattern[32];
	const char *p;
	char *end;

	snprintk(pattern, sizeof(pattern), "\"%s\"", key);
	p = strstr(buf, pattern);
	if (!p) {
		return false;
	}
	p = strchr(p + strlen(pattern), ':');
	if (!p) {
		return false;
	}
	p++;
	while (*p == ' ') {
		p++;
	}
	*out = strtol(p, &end, 10);
	return end != p;
}

/* "AA:BB:CC:DD:EE:FF" -> 6 bytes, ordem humana (indice 0 = primeiro
 * byte impresso) - a inversao pra ordem interna do stack fica por
 * conta de uart_link_send_actuator_manage(). */
static bool parse_mac(const char *mac_str, uint8_t mac[6])
{
	const char *p = mac_str;

	for (int i = 0; i < 6; i++) {
		char byte_str[3];
		char *end;

		if (!p[0] || !p[1]) {
			return false;
		}
		byte_str[0] = p[0];
		byte_str[1] = p[1];
		byte_str[2] = '\0';
		mac[i] = (uint8_t)strtol(byte_str, &end, 16);
		if (end != &byte_str[2]) {
			return false;
		}
		p += 2;
		if (i < 5) {
			if (*p != ':') {
				return false;
			}
			p++;
		}
	}
	return true;
}

/* "0a1b2c" -> bytes. Retorna a quantidade de bytes decodificados, ou
 * -1 se a string for invalida (tamanho impar, caractere nao-hex) ou
 * nao couber em out_cap. */
static int hex_decode(const char *hex, uint8_t *out, size_t out_cap)
{
	size_t hex_len = strlen(hex);
	size_t n;

	if (hex_len % 2 != 0) {
		return -1;
	}
	n = hex_len / 2;
	if (n > out_cap) {
		return -1;
	}
	for (size_t i = 0; i < n; i++) {
		char byte_str[3] = {hex[i * 2], hex[i * 2 + 1], '\0'};
		char *end;

		out[i] = (uint8_t)strtol(byte_str, &end, 16);
		if (end != &byte_str[2]) {
			return -1;
		}
	}
	return (int)n;
}

static void hex_encode(const uint8_t *data, uint8_t len, char *out, size_t out_cap)
{
	size_t n = 0;

	for (uint8_t i = 0; i < len && n + 2 < out_cap; i++) {
		n += snprintk(&out[n], out_cap - n, "%02x", data[i]);
	}
	out[n] = '\0';
}

/* --- Dispatch dos comandos (roda na system workqueue, ver nota do topo) --- */

#define MAX_ACTUATOR_CMD_LEN 64
#define MAX_GATEWAY_CTRL_ARG_LEN 16

static void handle_command(const char *json)
{
	char op[24];

	if (!json_get_str(json, "op", op, sizeof(op))) {
		LOG_WRN("Comando MQTT sem \"op\": %s", json);
		return;
	}

	if (strcmp(op, "get_status_all") == 0) {
		uart_link_get_status_all();
	} else if (strcmp(op, "get_status") == 0) {
		long slot;

		if (!json_get_int(json, "slot", &slot)) {
			LOG_WRN("get_status sem \"slot\" valido");
			return;
		}
		uart_link_get_status((uint8_t)slot);
	} else if (strcmp(op, "get_discovered") == 0) {
		uart_link_get_discovered_all();
	} else if (strcmp(op, "actuator_cmd") == 0) {
		long slot;
		char hex[2 * MAX_ACTUATOR_CMD_LEN + 1];
		uint8_t data[MAX_ACTUATOR_CMD_LEN];
		int dlen;

		if (!json_get_int(json, "slot", &slot) ||
		    !json_get_str(json, "data", hex, sizeof(hex))) {
			LOG_WRN("actuator_cmd sem \"slot\"/\"data\" validos");
			return;
		}
		dlen = hex_decode(hex, data, sizeof(data));
		if (dlen < 0) {
			LOG_WRN("actuator_cmd: \"data\" nao e' hex valido");
			return;
		}
		uart_link_send_actuator_cmd((uint8_t)slot, data, (uint8_t)dlen);
	} else if (strcmp(op, "actuator_manage") == 0) {
		long cmd, addr_type;
		char mac_str[18];
		uint8_t mac[6];

		if (!json_get_int(json, "cmd", &cmd) ||
		    !json_get_int(json, "addr_type", &addr_type) ||
		    !json_get_str(json, "mac", mac_str, sizeof(mac_str)) ||
		    !parse_mac(mac_str, mac)) {
			LOG_WRN("actuator_manage: campos invalidos");
			return;
		}
		uart_link_send_actuator_manage((uint8_t)cmd, (uint8_t)addr_type, mac);
	} else if (strcmp(op, "gateway_ctrl") == 0) {
		long cmd;
		char hex[2 * MAX_GATEWAY_CTRL_ARG_LEN + 1];
		uint8_t arg[MAX_GATEWAY_CTRL_ARG_LEN];
		int alen = 0;

		if (!json_get_int(json, "cmd", &cmd)) {
			LOG_WRN("gateway_ctrl sem \"cmd\"");
			return;
		}
		if (json_get_str(json, "arg", hex, sizeof(hex))) {
			alen = hex_decode(hex, arg, sizeof(arg));
			if (alen < 0) {
				LOG_WRN("gateway_ctrl: \"arg\" nao e' hex valido, ignorando arg");
				alen = 0;
			}
		}
		uart_link_send_gateway_ctrl((uint8_t)cmd, arg, (uint8_t)alen);
	} else {
		LOG_WRN("Comando MQTT desconhecido: op=\"%s\"", op);
	}
}

static void cmd_work_handler(struct k_work *work)
{
	struct pending_cmd cmd;

	ARG_UNUSED(work);

	while (k_msgq_get(&cmd_msgq, &cmd, K_NO_WAIT) == 0) {
		handle_command(cmd.json);
	}
}

static void enqueue_command(const char *json, size_t len)
{
	struct pending_cmd cmd;
	size_t n = MIN(len, sizeof(cmd.json) - 1);

	memcpy(cmd.json, json, n);
	cmd.json[n] = '\0';

	if (k_msgq_put(&cmd_msgq, &cmd, K_NO_WAIT) != 0) {
		LOG_WRN("Fila de comandos cheia, descartando: %s", cmd.json);
		return;
	}
	k_work_submit(&cmd_work);
}

/* --- LTE / modem / certificado (quase inalterado do l4_e2) --- */

/* Achado em bancada (2026-08-15): o handler original so logava o
 * status de registro quando JA tinha registrado - qualquer outro
 * status (procurando, negado, sem SIM...) caia no default silencioso,
 * entao uma LTE que nunca registra fica sem log nenhum, indistinguivel
 * de "ainda nao tentou". Log incondicional agora, pra sempre ter pista
 * de onde travou. */
static const char *nw_reg_status_name(enum lte_lc_nw_reg_status status)
{
	switch (status) {
	case LTE_LC_NW_REG_NOT_REGISTERED:
		return "nao registrado";
	case LTE_LC_NW_REG_REGISTERED_HOME:
		return "registrado (rede local)";
	case LTE_LC_NW_REG_SEARCHING:
		return "procurando rede";
	case LTE_LC_NW_REG_REGISTRATION_DENIED:
		return "registro negado";
	case LTE_LC_NW_REG_UNKNOWN:
		return "desconhecido";
	case LTE_LC_NW_REG_REGISTERED_ROAMING:
		return "registrado (roaming)";
	case LTE_LC_NW_REG_UICC_FAIL:
		return "falha no SIM/UICC";
	case LTE_LC_NW_REG_NO_SUITABLE_CELL:
		return "nenhuma celula adequada encontrada";
	default:
		return "?";
	}
}

static const char *modem_evt_name(enum lte_lc_modem_evt_type type)
{
	switch (type) {
	case LTE_LC_MODEM_EVT_LIGHT_SEARCH_DONE:
		return "LIGHT_SEARCH_DONE";
	case LTE_LC_MODEM_EVT_SEARCH_DONE:
		return "SEARCH_DONE";
	case LTE_LC_MODEM_EVT_RESET_LOOP:
		return "RESET_LOOP (modem reiniciando em loop!)";
	case LTE_LC_MODEM_EVT_BATTERY_LOW:
		return "BATTERY_LOW";
	case LTE_LC_MODEM_EVT_OVERHEATED:
		return "OVERHEATED";
	case LTE_LC_MODEM_EVT_NO_IMEI:
		return "NO_IMEI (falha de hardware/provisionamento!)";
	case LTE_LC_MODEM_EVT_CE_LEVEL:
		return "CE_LEVEL";
	case LTE_LC_MODEM_EVT_RF_CAL_NOT_DONE:
		return "RF_CAL_NOT_DONE";
	case LTE_LC_MODEM_EVT_INVALID_BAND_CONF:
		return "INVALID_BAND_CONF";
	case LTE_LC_MODEM_EVT_DETECTED_COUNTRY:
		return "DETECTED_COUNTRY";
	default:
		return "?";
	}
}

static void lte_handler(const struct lte_lc_evt *const evt)
{
	switch (evt->type) {
	case LTE_LC_EVT_NW_REG_STATUS:
		LOG_INF("Network registration status: %s (%d)",
			nw_reg_status_name(evt->nw_reg_status), evt->nw_reg_status);
		if ((evt->nw_reg_status != LTE_LC_NW_REG_REGISTERED_HOME) &&
		    (evt->nw_reg_status != LTE_LC_NW_REG_REGISTERED_ROAMING)) {
			break;
		}
		k_sem_give(&lte_connected);
		break;
	case LTE_LC_EVT_RRC_UPDATE:
		LOG_INF("RRC mode: %s",
			evt->rrc_mode == LTE_LC_RRC_MODE_CONNECTED ? "Connected" : "Idle");
		break;
	case LTE_LC_EVT_MODEM_EVENT:
		LOG_INF("Modem event: %s", modem_evt_name(evt->modem_evt.type));
		break;
	default:
		break;
	}
}

static int certificate_provision(void)
{
	int err = 0;
	bool exists;

	err = modem_key_mgmt_exists(CONFIG_MQTT_HELPER_SEC_TAG, MODEM_KEY_MGMT_CRED_TYPE_CA_CHAIN,
				     &exists);
	if (err) {
		LOG_ERR("Failed to check for certificates err %d", err);
		return err;
	}

	if (exists) {
		err = modem_key_mgmt_cmp(CONFIG_MQTT_HELPER_SEC_TAG,
					  MODEM_KEY_MGMT_CRED_TYPE_CA_CHAIN, ca_certificate,
					  sizeof(ca_certificate) - 1);
		LOG_INF("Comparing credentials: %s", err ? "Mismatch" : "Match");
		if (!err) {
			return 0;
		}
	}

	err = modem_key_mgmt_write(CONFIG_MQTT_HELPER_SEC_TAG, MODEM_KEY_MGMT_CRED_TYPE_CA_CHAIN,
				    ca_certificate, sizeof(ca_certificate) - 1);
	if (err) {
		LOG_ERR("Failed to provision CA certificate: %d", err);
		return err;
	}

	return 0;
}

static int modem_configure(void)
{
	int err;

	LOG_INF("Initializing modem library");
	err = nrf_modem_lib_init();
	if (err) {
		LOG_ERR("Failed to initialize the modem library, error: %d", err);
		return err;
	}

	/* Certificado provisionado com o modem offline, antes de conectar. */
	err = certificate_provision();
	if (err) {
		LOG_ERR("Failed to provision certificates");
		return err;
	}

	LOG_INF("Connecting to LTE network");
	err = lte_lc_connect_async(lte_handler);
	if (err) {
		LOG_ERR("Error in lte_lc_connect_async, error: %d", err);
		return err;
	}

	k_sem_take(&lte_connected, K_FOREVER);
	LOG_INF("Connected to LTE network");

	return 0;
}

static int client_id_get(char *buffer, size_t buffer_len)
{
	int len;
	int err;
	char imei_buf[CGSN_RESPONSE_LENGTH];

	if (!buffer || buffer_len == 0) {
		LOG_ERR("Invalid buffer parameters");
		return -EINVAL;
	}

	if (strlen(CONFIG_SIMCONNECT_MQTT_CLIENT_ID) > 0) {
		len = snprintk(buffer, buffer_len, "%s", CONFIG_SIMCONNECT_MQTT_CLIENT_ID);
		if ((len < 0) || (len >= (int)buffer_len)) {
			LOG_ERR("Failed to format client ID from config, error: %d", len);
			return -EMSGSIZE;
		}
		return 0;
	}

	err = nrf_modem_at_cmd(imei_buf, sizeof(imei_buf), "AT+CGSN");
	if (err) {
		LOG_ERR("Failed to obtain IMEI, error: %d", err);
		return err;
	}

	imei_buf[IMEI_LEN] = '\0';

	len = snprintk(buffer, buffer_len, "nrf-%.*s", IMEI_LEN, imei_buf);
	if ((len < 0) || (len >= (int)buffer_len)) {
		LOG_ERR("Failed to format client ID from IMEI, error: %d", len);
		return -EMSGSIZE;
	}

	return 0;
}

/* --- MQTT: publish/subscribe --- */

/* Nome "publish_message" (nao "mqtt_publish") de proposito - colide
 * com a funcao mqtt_publish() ja declarada em zephyr/net/mqtt.h
 * (incluido via mqtt_helper.h), mesmo sendo static. */
static int publish_message(const char *topic, const void *data, size_t len, bool retain)
{
	struct mqtt_publish_param param = {0};

	param.message.payload.data = (uint8_t *)data;
	param.message.payload.len = len;
	param.message.topic.qos = MQTT_QOS_1_AT_LEAST_ONCE;
	param.message.topic.topic.utf8 = (uint8_t *)topic;
	param.message.topic.topic.size = strlen(topic);
	param.message_id = mqtt_helper_msg_id_get();
	param.dup_flag = 0;
	param.retain_flag = retain ? 1 : 0;

	return mqtt_helper_publish(&param);
}

static void subscribe(void)
{
	int err;
	struct mqtt_topic subscribe_topic = {
		.topic = {.utf8 = (uint8_t *)cmd_topic, .size = strlen(cmd_topic)},
		.qos = MQTT_QOS_1_AT_LEAST_ONCE};
	struct mqtt_subscription_list subscription_list = {
		.list = &subscribe_topic, .list_count = 1, .message_id = SUBSCRIBE_TOPIC_ID};

	LOG_INF("Subscribing to %s", cmd_topic);
	err = mqtt_helper_subscribe(&subscription_list);
	if (err) {
		LOG_ERR("Failed to subscribe to topics, error: %d", err);
	}
}

static void on_mqtt_connack(enum mqtt_conn_return_code return_code, bool session_present)
{
	ARG_UNUSED(session_present);

	if (return_code != MQTT_CONNECTION_ACCEPTED) {
		LOG_WRN("Connection to broker not established, return_code: %d", return_code);
		return;
	}

	LOG_INF("Connected to MQTT broker");
	LOG_INF("Hostname: %s", CONFIG_SIMCONNECT_MQTT_BROKER_HOSTNAME);
	LOG_INF("Client ID: %s", (char *)client_id);

	mqtt_connected = true;
	subscribe();

	/* Sincronizacao inicial (docs/PROTOCOLO_91_MQTT.md, "Gatilho de
	 * sincronizacao inicial") - via a mesma fila que comandos vindos
	 * de fora usam, ver nota grande no topo do arquivo. */
	enqueue_command("{\"op\":\"get_status_all\"}", 22);
	enqueue_command("{\"op\":\"get_discovered\"}", 22);
}

static void on_mqtt_suback(uint16_t message_id, int result)
{
	if (result != MQTT_SUBACK_FAILURE) {
		if (message_id == SUBSCRIBE_TOPIC_ID) {
			LOG_INF("Subscribed to %s with QoS %d", cmd_topic, result);
			return;
		}
		LOG_WRN("Subscribed to unknown topic, id: %d with QoS %d", message_id, result);
		return;
	}
	LOG_ERR("Topic subscription failed, error: %d", result);
}

static void on_mqtt_publish(struct mqtt_helper_buf topic, struct mqtt_helper_buf payload)
{
	ARG_UNUSED(topic);

	LOG_INF("Comando MQTT recebido (%u bytes)", payload.size);
	enqueue_command(payload.ptr, payload.size);
}

static void on_mqtt_disconnect(int result)
{
	LOG_INF("MQTT client disconnected: %d", result);
	mqtt_connected = false;
}

/* --- API publica --- */

int mqtt_client_start(void)
{
	int err;

	snprintk(cmd_topic, sizeof(cmd_topic), "%s/cmd", CONFIG_SIMCONNECT_MQTT_TOPIC_PREFIX);

	k_work_init(&cmd_work, cmd_work_handler);

	err = modem_configure();
	if (err) {
		LOG_ERR("Failed to configure the modem, error: %d", err);
		return err;
	}

	struct mqtt_helper_cfg config = {
		.cb =
			{
				.on_connack = on_mqtt_connack,
				.on_disconnect = on_mqtt_disconnect,
				.on_publish = on_mqtt_publish,
				.on_suback = on_mqtt_suback,
			},
	};

	err = mqtt_helper_init(&config);
	if (err) {
		LOG_ERR("Failed to initialize MQTT helper, error: %d", err);
		return err;
	}

	err = client_id_get(client_id, sizeof(client_id));
	if (err) {
		LOG_ERR("Failed to get client ID, error: %d", err);
		return err;
	}

	struct mqtt_helper_conn_params conn_params = {
		.hostname.ptr = CONFIG_SIMCONNECT_MQTT_BROKER_HOSTNAME,
		.hostname.size = strlen(CONFIG_SIMCONNECT_MQTT_BROKER_HOSTNAME),
		.device_id.ptr = (char *)client_id,
		.device_id.size = strlen((char *)client_id),
	};

	err = mqtt_helper_connect(&conn_params);
	if (err) {
		LOG_ERR("Failed to connect to MQTT, error code: %d", err);
		return err;
	}

	return 0;
}

void mqtt_client_publish_status(uint8_t slot, const char *state, uint8_t addr_type,
				 const char *mac, const char *name)
{
	char topic[64];
	char payload[192];
	int len;

	if (!mqtt_connected) {
		return;
	}

	snprintk(topic, sizeof(topic), "%s/actuator/%u/status", CONFIG_SIMCONNECT_MQTT_TOPIC_PREFIX,
		 slot);
	len = snprintk(payload, sizeof(payload),
		       "{\"slot\":%u,\"state\":\"%s\",\"addr_type\":%u,\"mac\":\"%s\","
		       "\"name\":\"%s\"}",
		       slot, state, addr_type, mac, name);
	if (len < 0 || len >= (int)sizeof(payload)) {
		LOG_WRN("Payload de status truncado, nao publicado");
		return;
	}

	if (publish_message(topic, payload, (size_t)len, true)) {
		LOG_WRN("Falha ao publicar status do slot %u", slot);
	}
}

void mqtt_client_publish_discovery(uint8_t addr_type, const char *mac, int8_t rssi, uint8_t flags,
				    const char *name)
{
	char topic_mac[13]; /* MAC sem dois-pontos, 12 hex + \0 */
	char topic[80];
	char payload[160];
	int len;
	size_t j = 0;

	if (!mqtt_connected) {
		return;
	}

	/* Remove os ':' do MAC pra usar como segmento de topico. */
	for (size_t i = 0; mac[i] != '\0' && j < sizeof(topic_mac) - 1; i++) {
		if (mac[i] != ':') {
			topic_mac[j++] = mac[i];
		}
	}
	topic_mac[j] = '\0';

	snprintk(topic, sizeof(topic), "%s/discovery/%s", CONFIG_SIMCONNECT_MQTT_TOPIC_PREFIX,
		 topic_mac);
	len = snprintk(payload, sizeof(payload),
		       "{\"addr_type\":%u,\"mac\":\"%s\",\"rssi\":%d,\"flags\":%u,\"name\":\"%s\"}",
		       addr_type, mac, rssi, flags, name);
	if (len < 0 || len >= (int)sizeof(payload)) {
		LOG_WRN("Payload de descoberta truncado, nao publicado");
		return;
	}

	if (publish_message(topic, payload, (size_t)len, true)) {
		LOG_WRN("Falha ao publicar descoberta de %s", mac);
	}
}

void mqtt_client_publish_raw(uint8_t slot, const uint8_t *data, uint8_t len)
{
	char topic[64];
	char hex[2 * 250 + 1];
	char payload[2 * 250 + 32];
	int plen;

	if (!mqtt_connected) {
		return;
	}

	hex_encode(data, len, hex, sizeof(hex));

	snprintk(topic, sizeof(topic), "%s/actuator/%u/raw", CONFIG_SIMCONNECT_MQTT_TOPIC_PREFIX,
		 slot);
	plen = snprintk(payload, sizeof(payload), "{\"slot\":%u,\"data\":\"%s\"}", slot, hex);
	if (plen < 0 || plen >= (int)sizeof(payload)) {
		LOG_WRN("Payload de raw truncado, nao publicado");
		return;
	}

	if (publish_message(topic, payload, (size_t)plen, false)) {
		LOG_WRN("Falha ao publicar raw do slot %u", slot);
	}
}

void mqtt_client_publish_result(const char *op, uint8_t seq_original, uint8_t err)
{
	char topic[48];
	char payload[64];
	int len;

	if (!mqtt_connected) {
		return;
	}

	snprintk(topic, sizeof(topic), "%s/result", CONFIG_SIMCONNECT_MQTT_TOPIC_PREFIX);
	len = snprintk(payload, sizeof(payload), "{\"op\":\"%s\",\"seq\":%u,\"err\":%u}", op,
		       seq_original, err);
	if (len < 0 || len >= (int)sizeof(payload)) {
		LOG_WRN("Payload de result truncado, nao publicado");
		return;
	}

	if (publish_message(topic, payload, (size_t)len, false)) {
		LOG_WRN("Falha ao publicar result (%s)", op);
	}
}
```

## src/mqtt_client.h
```c
/*
 * Coester - SIM Connect (nRF9151)
 *
 * Integracao MQTT - contrato completo em docs/PROTOCOLO_91_MQTT.md.
 * Base reaproveitada de C:\NordicAcademy\cell-fund\l4\l4_e2 (Nordic
 * Academy, Cellular IoT Fundamentals, Licao 4 Exercicio 2).
 */

#ifndef MQTT_CLIENT_H_
#define MQTT_CLIENT_H_

#ifdef __cplusplus
extern "C" {
#endif

#include <zephyr/types.h>

/** @brief Configura o modem, conecta na rede LTE (bloqueia ate
 *         registrar - pode demorar em campo real), provisiona o
 *         certificado TLS e inicia a conexao com o broker MQTT
 *         (assincrona a partir dai - eventos chegam via callback).
 *
 * @retval 0 sequencia de setup concluida sem erro imediato.
 * @retval <0 falha em algum passo (modem, LTE, certificado ou MQTT).
 */
int mqtt_client_start(void);

/** @brief Publica o registro de status de um slot (retained) -
 *         topico `<prefixo>/actuator/<slot>/status`. Sem efeito se
 *         nao estiver conectado ao broker.
 */
void mqtt_client_publish_status(uint8_t slot, const char *state, uint8_t addr_type,
				 const char *mac, const char *name);

/** @brief Publica um registro de descoberta (retained) - topico
 *         `<prefixo>/discovery/<mac_sem_dois_pontos>`.
 */
void mqtt_client_publish_discovery(uint8_t addr_type, const char *mac, int8_t rssi, uint8_t flags,
				    const char *name);

/** @brief Publica a resposta crua de um atuador (RAW_DATA), hex-
 *         encoded, nao retained - topico `<prefixo>/actuator/<slot>/raw`.
 *         E' o canal por onde volta o dado sob demanda pedido via
 *         `actuator_cmd` (curva, evento, etc.).
 */
void mqtt_client_publish_raw(uint8_t slot, const uint8_t *data, uint8_t len);

/** @brief Publica o resultado de um comando administrativo
 *         (MANAGE_RESULT/GATEWAY_CTRL_RESULT), nao retained - topico
 *         `<prefixo>/result`.
 *
 * @param op "actuator_manage" ou "gateway_ctrl".
 */
void mqtt_client_publish_result(const char *op, uint8_t seq_original, uint8_t err);

#ifdef __cplusplus
}
#endif

#endif /* MQTT_CLIENT_H_ */
```

## src/uart_link.h
```c
/*
 * Coester - SIM Connect (nRF9151)
 *
 * Espelho do link UART com o nRF54 (Gateway) - contrato completo em
 * docs/PROTOCOLO_54_91.md (repositorio principal). Fase 4: so
 * decodifica e loga os registros que chegam do 54 (STATUS_RECORD,
 * DISCOVERED_RECORD, RAW_DATA, MANAGE_RESULT, GATEWAY_CTRL_RESULT) -
 * sem MQTT ainda. O modulo ja nasce separado do main.c mesmo sem
 * estritamente precisar agora, porque a fase de MQTT (proxima depois
 * desta) vai precisar chamar estas mesmas funcoes de fora.
 */

#ifndef UART_LINK_H_
#define UART_LINK_H_

#ifdef __cplusplus
extern "C" {
#endif

#include <zephyr/types.h>

/** @brief Inicializa o link UART com o 54 (device uart1/arduino_serial).
 *
 * @retval 0 Link pronto.
 * @retval <0 Falha (device nao pronto, callback ou RX).
 */
int uart_link_init(void);

/** @brief Gatilho de teste (TEMPORARIO - ver docs/PROTOCOLO_54_91.md,
 *         secao "Decisoes tomadas"): pede GET_STATUS de cada slot
 *         (0..GATEWAY_MAX_ACTUATORS-1) em sequencia, um de cada vez -
 *         evita ter que fragmentar a leitura em lote (mesma logica que
 *         a interface web ja usa contra o Gateway via BLE).
 *
 *  Quando a integracao MQTT existir, o gatilho principal passa a ser
 *  "ao conectar no broker", com isto sobrando como forma manual de
 *  forcar resync.
 */
void uart_link_get_status_all(void);

/** @brief Gatilho de teste (TEMPORARIO): pede GET_DISCOVERED de todos
 *         os atuadores vistos no scan do Gateway (indice 0xFF).
 */
void uart_link_get_discovered_all(void);

/** @brief Pede GET_STATUS de um unico slot (0x14) - usado pelo
 *         comando MQTT `{"op":"get_status","slot":N}`, ver
 *         docs/PROTOCOLO_91_MQTT.md.
 */
void uart_link_get_status(uint8_t slot);

/** @brief Repassa um comando cru do proCo pro atuador de um slot
 *         (ACTUATOR_CMD, 0x10) - e' o mecanismo de "dado sob demanda"
 *         (curva, evento, etc.) pedido via MQTT
 *         (`{"op":"actuator_cmd","slot":N,"data":"<hex>"}`). A
 *         resposta do atuador chega depois como `RAW_DATA`, publicada
 *         por `mqtt_client_publish_raw()`.
 */
void uart_link_send_actuator_cmd(uint8_t slot, const uint8_t *data, uint8_t len);

/** @brief Adiciona/remove um atuador da allow-list do Gateway
 *         (ACTUATOR_MANAGE, 0x12).
 *
 * @param mac_human Endereco no formato humano (AA:BB:CC:DD:EE:FF,
 *                   indice 0 = primeiro byte) - a inversao pra ordem
 *                   interna do stack que o frame exige e' feita aqui
 *                   dentro, mesma logica de `format_mac()`.
 */
void uart_link_send_actuator_manage(uint8_t cmd, uint8_t addr_type, const uint8_t mac_human[6]);

/** @brief Comando administrativo do Gateway (GATEWAY_CTRL, 0x18) -
 *         limpar descoberta, reiniciar scan, desconectar slot, mudar
 *         velocidade. Ver tabela de `cmd` em docs/PROTOCOLO_54_91.md.
 *         `arg`/`arg_len` podem ser `NULL`/`0` pros comandos que nao
 *         precisam de argumento.
 */
void uart_link_send_gateway_ctrl(uint8_t cmd, const uint8_t *arg, uint8_t arg_len);

#ifdef __cplusplus
}
#endif

#endif /* UART_LINK_H_ */
```
